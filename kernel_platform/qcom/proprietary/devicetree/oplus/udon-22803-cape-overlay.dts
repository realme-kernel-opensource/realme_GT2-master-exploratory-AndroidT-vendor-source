/dts-v1/;
/plugin/;
#include <dt-bindings/oplus/hw-id.h>
#include "../qcom/cape-mtp-pm8010-overlay.dts"
#include "cape_overlay_common.dtsi"
#include "udon_22803_overlay_common.dtsi"
#include "nfc/jennie-nfc-sn100t.dtsi"
#include "tp/oplus_tp_overlay_common.dtsi"
#include "oplus_uff/oplus_uff_sm8475.dtsi"
#include "sensor/jennie-oplus-sensor.dtsi"
#include "shouder/jennie_shouder_chipsea_f71.dtsi"
#include "oplus_chg/oplus-chg-21605.dtsi"
/ {
        model = "Qualcomm Technologies, Inc. Cape MTP, Udon";
        oplus,project-id = <22803 22881>;
        oplus,hw-id = <OPLUS_EVB1 OPLUS_T0 OPLUS_EVT1 OPLUS_DVT1 OPLUS_PVT1 OPLUS_PVT2 OPLUS_MP1>;
};

&pm8350b_haptics {
    qcom,vmax-mv = <1280>;
    qcom,cl-vmax-mv = <1280>;
    qcom,lra-period-us = <5882>;
    qcom,fifo-vmax-mv = <9100>;
    qcom,old-steady-vmax-mv = <9100>;
    qcom,cal-data-restore;
    qcom,vibrator-type = <809>;//ela0809
};